## CMakeLists.txt
```
# SPDX-License-Identifier: Apache-2.0

cmake_minimum_required(VERSION 3.20.0)
find_package(Zephyr REQUIRED HINTS $ENV{ZEPHYR_BASE})
project(inter_l1)

target_sources(app PRIVATE src/main.c)
```

## prj.conf
```kconfig
CONFIG_GPIO=y
CONFIG_LOG=y
CONFIG_ASSERT=y

CONFIG_DEBUG_THREAD_INFO=y
CONFIG_DEBUG_OPTIMIZATIONS=y

CONFIG_ENTROPY_GENERATOR=y

CONFIG_INTER_L1_MESSAGE_QUEUE=n
CONFIG_INTER_L1_FIFO=y

CONFIG_HEAP_MEM_POOL_SIZE=1024
```

## src/main.c
```c
/*
 * Copyright (c) 2024 Nordic Semiconductor ASA
 *
 * SPDX-License-Identifier: LicenseRef-Nordic-5-Clause
 */

#include <stdio.h>
#include <zephyr/kernel.h>
#include <zephyr/drivers/gpio.h>
#include <zephyr/logging/log.h>
#include <zephyr/random/random.h>

/* The devicetree node identifier for the "led0"  and "led1" alias. */
#define LED0_NODE DT_ALIAS(led0)
#define LED1_NODE DT_ALIAS(led1)

/* 2200 msec = 2.2 sec */
#define PRODUCER_SLEEP_TIME_MS 2200

#ifdef CONFIG_INTER_L1_MESSAGE_QUEUE
	LOG_MODULE_REGISTER(Less1_Exer1, LOG_LEVEL_DBG);
	/* Stack size for both the producer and consumer threads */
	#define STACKSIZE		 2048
	#define PRODUCER_THREAD_PRIORITY 6
	#define CONSUMER_THREAD_PRIORITY 7
#endif

#ifdef CONFIG_INTER_L1_FIFO
	LOG_MODULE_REGISTER(Less1_Exer2, LOG_LEVEL_DBG);
	/* Stack size for both the producer and consumer threads */
	#define STACKSIZE		 2048
	#define PRODUCER_THREAD_PRIORITY 6
	#define CONSUMER_THREAD_PRIORITY 7
	#define MAX_DATA_SIZE		 32
	#define MIN_DATA_ITEMS		 4
	#define MAX_DATA_ITEMS		 14
#endif

static const struct gpio_dt_spec led0 = GPIO_DT_SPEC_GET(LED0_NODE, gpios);
static const struct gpio_dt_spec led1 = GPIO_DT_SPEC_GET(LED1_NODE, gpios);

static void timer0_handler(struct k_timer *dummy)
{
    /*Interrupt Context - System Timer ISR */
    static bool flip= true;
    if (flip)
        gpio_pin_toggle_dt(&led0);
    else
        gpio_pin_toggle_dt(&led1);

    flip = !flip;
}

K_TIMER_DEFINE(timer0, timer0_handler, NULL);

#ifdef CONFIG_INTER_L1_MESSAGE_QUEUE
typedef struct {
	uint32_t x_reading;
	uint32_t y_reading;
	uint32_t z_reading;
} SensorReading;

K_MSGQ_DEFINE(device_message_queue, sizeof(SensorReading), 16, 4);
#endif

#ifdef CONFIG_INTER_L1_FIFO
struct data_item_t {
	void *fifo_reserved;
	uint8_t  data[MAX_DATA_SIZE];
	uint16_t len;
}; 

K_FIFO_DEFINE(my_fifo);
#endif

int main(void)
{
	int ret;

	if (!gpio_is_ready_dt(&led0)) {
		return 0;
	}

	ret = gpio_pin_configure_dt(&led0, GPIO_OUTPUT_ACTIVE);
	if (ret < 0) {
		return 0;
	}
	ret = gpio_pin_configure_dt(&led1, GPIO_OUTPUT_ACTIVE);
	if (ret < 0) {
		return 0;
	}
	/* start periodic timer that expires once every 0.5 second  */
	k_timer_start(&timer0, K_MSEC(500), K_MSEC(500));

	return 0;
}

static void producer_func(void *unused1, void *unused2, void *unused3)
{
	ARG_UNUSED(unused1);
	ARG_UNUSED(unused2);
	ARG_UNUSED(unused3);
#ifdef CONFIG_INTER_L1_FIFO
	static uint32_t dataitem_count = 0;
#endif

	while (1) {
#ifdef CONFIG_INTER_L1_MESSAGE_QUEUE
		static SensorReading acc_val = {100, 100, 100};
		int ret;
		
		ret = k_msgq_put(&device_message_queue,&acc_val,K_FOREVER);
		if (ret){
			LOG_ERR("Return value from k_msgq_put = %d",ret);
		}

		acc_val.x_reading += 1;
		acc_val.y_reading += 1;
		acc_val.z_reading += 1;
		k_msleep(PRODUCER_SLEEP_TIME_MS);
#endif

#ifdef CONFIG_INTER_L1_FIFO
		int bytes_written;
		/* Generate a random number between MIN_DATA_ITEMS & MAX_DATA_ITEMS to represent the number
		of data items to send every time the producer thread is scheduled */
		uint32_t data_number = MIN_DATA_ITEMS + sys_rand32_get() % (MAX_DATA_ITEMS - MIN_DATA_ITEMS + 1);
		for (int i = 0; i < data_number; i++) {
			/* Create a data item to send */
			struct data_item_t *buf = k_malloc(sizeof(struct data_item_t));
			if (buf == NULL) {
				/* Unable to locate memory from the heap */
				LOG_ERR("Unable to allocate memory");
				return;
			}
			bytes_written = snprintf(buf->data, MAX_DATA_SIZE, "Data Seq. %u:\t%u",
						dataitem_count, sys_rand32_get());
			buf->len = bytes_written;
			dataitem_count++;
			k_fifo_put(&my_fifo, buf);
		}
		LOG_INF("Producer: Data Items Generated: %u", data_number);
		k_msleep(PRODUCER_SLEEP_TIME_MS);
#endif
	}
}

static void consumer_func(void *unused1, void *unused2, void *unused3)
{
	ARG_UNUSED(unused1);
	ARG_UNUSED(unused2);
	ARG_UNUSED(unused3);

	while (1) {
#ifdef CONFIG_INTER_L1_MESSAGE_QUEUE
		SensorReading temp;
		int ret;
		
		ret = k_msgq_get(&device_message_queue,&temp,K_FOREVER);
        if (ret){
            LOG_ERR("Return value from k_msgq_get = %d",ret);
        }

		LOG_INF("Values got from the queue: %d.%d.%d\r\n", temp.x_reading, temp.y_reading,temp.z_reading);
#endif

#ifdef CONFIG_INTER_L1_FIFO
		struct data_item_t *rec_item;
        rec_item = k_fifo_get(&my_fifo, K_FOREVER);
        LOG_INF("Consumer: %s\tSize: %u",rec_item->data,rec_item->len);
        k_free(rec_item);
#endif
	}
}

K_THREAD_DEFINE(producer, STACKSIZE, producer_func, NULL, NULL, NULL, PRODUCER_THREAD_PRIORITY, 0, 0);
K_THREAD_DEFINE(consumer, STACKSIZE, consumer_func, NULL, NULL, NULL, CONSUMER_THREAD_PRIORITY, 0, 0);
```
