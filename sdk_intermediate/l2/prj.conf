## CMakeLists.txt
```
#
# Copyright (c) 2024 Nordic Semiconductor
#
# SPDX-License-Identifier: LicenseRef-Nordic-5-Clause
#

cmake_minimum_required(VERSION 3.20.0)
find_package(Zephyr REQUIRED HINTS $ENV{ZEPHYR_BASE})
project(inter_l2)

target_sources(app PRIVATE src/main.c)
```

## prj.conf
```kconfig
#
# Copyright (c) 2024 Nordic Semiconductor
#
# SPDX-License-Identifier: LicenseRef-Nordic-5-Clause
#
CONFIG_LOG=y
CONFIG_GPIO=y

CONFIG_DK_LIBRARY=y

CONFIG_DEBUG_COREDUMP=y
CONFIG_DEBUG_COREDUMP_BACKEND_LOGGING=y

# Additional config to avoid overlapping serial output messages from coredump and logging
CONFIG_LOG_MODE_IMMEDIATE=y
CONFIG_PRINTK_SYNC=y
CONFIG_LOG_PRINTK=y

# To get all registers (including r4-r11) into the coredump to unwind correctly the call stack
CONFIG_EXTRA_EXCEPTION_INFO=y
```

## boards/nrf54l15dk_nrf54l15_cpuapp_ns.overlay
```dts
&gpio0 {
	status = "okay";
};
```

## src/main.c
```c
/*
 * Copyright (c) 2024 Nordic Semiconductor ASA
 *
 * SPDX-License-Identifier: LicenseRef-Nordic-5-Clause
 */

#include <zephyr/kernel.h>
#include <zephyr/logging/log.h>
#include <zephyr/debug/coredump.h>

#include <dk_buttons_and_leds.h>

LOG_MODULE_REGISTER(Lesson2_Exercise2, LOG_LEVEL_INF);

void crash_function(uint32_t *addr)
{
	LOG_INF("Button pressed at %" PRIu32, k_cycle_get_32());
	LOG_INF("Coredump: %s", CONFIG_BOARD);

	#if !defined(CONFIG_CPU_CORTEX_M)
	/* For null pointer reference */
	*addr = 0;
	#else
		ARG_UNUSED(addr);
		/* Dereferencing null-pointer in TrustZone-enabled
	 	* builds may crash the system, so use, instead an
	 	* undefined instruction to trigger a CPU fault.
	 	*/
	__asm__ volatile("udf #0" : : : );
#endif
}

void button_handler(uint32_t button_state, uint32_t has_changed)
{
	if (has_changed & button_state)
	{
		switch (has_changed)
		{
            case DK_BTN1_MSK:
                LOG_INF("Button 1 pressed");
				// crash_function(0);
                break;
			default:
				break;
		}
    }
}

int main(void)
{
    if (dk_buttons_init(button_handler)) {
        LOG_ERR("Failed to initialize the buttons library");
    }

	LOG_INF("Press button 1 to get a fault error");

	return 0;
}
```
