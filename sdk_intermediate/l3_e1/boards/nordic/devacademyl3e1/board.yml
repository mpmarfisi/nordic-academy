## sdk_intermediate/l3_e1/boards/nordic/devacademyl3e1/board.yml
```yaml
board:
  name: devacademyl3e1
  full_name: devacademyl3e1
  vendor: nordic
  socs:
    - name: nrf52833
```

## sdk_intermediate/l3_e2/boards/nordic/devacademyl3e2/Kconfig
```kconfig
# Copyright (c) 2026 Nordic Semiconductor ASA
# SPDX-License-Identifier: Apache-2.0

config BOARD_DEVACADEMYL3E2
	select SOC_NRF54L10_DEVELOP_IN_NRF54L15 if SOC_NRF54L10
	select SOC_NRF54L05_DEVELOP_IN_NRF54L15 if SOC_NRF54L05
```

## sdk_intermediate/l3_e2/boards/nordic/devacademyl3e2/board.yml
```yaml
board:
  name: devacademyl3e2
  full_name: DevAcademyL3E2
  vendor: nordic
  socs:
    - name: nrf54l05
    - name: nrf54l10
      variants:
        - name: ns
          cpucluster: cpuapp
    - name: nrf54l15
      variants:
        - name: xip
          cpucluster: cpuflpr
        - name: ns
          cpucluster: cpuapp
runners:
  run_once:
    '--recover':
      - runners:
          - nrfjprog
          - nrfutil
        run: first
        groups:
          - boards:
              - devacademyl3e2/nrf54l05/cpuapp
              - devacademyl3e2/nrf54l10/cpuapp
              - devacademyl3e2/nrf54l10/cpuapp/ns
              - devacademyl3e2/nrf54l15/cpuapp
              - devacademyl3e2/nrf54l15/cpuapp/ns
              - devacademyl3e2/nrf54l15/cpuflpr
              - devacademyl3e2/nrf54l15/cpuflpr/xip
    '--erase':
      - runners:
          - nrfjprog
          - jlink
          - nrfutil
        run: first
        groups:
          - boards:
              - devacademyl3e2/nrf54l05/cpuapp
              - devacademyl3e2/nrf54l10/cpuapp
              - devacademyl3e2/nrf54l10/cpuapp/ns
              - devacademyl3e2/nrf54l15/cpuapp
              - devacademyl3e2/nrf54l15/cpuapp/ns
              - devacademyl3e2/nrf54l15/cpuflpr
              - devacademyl3e2/nrf54l15/cpuflpr/xip
    '--reset':
      - runners:
          - nrfjprog
          - jlink
          - nrfutil
        run: last
        groups:
          - boards:
              - devacademyl3e2/nrf54l05/cpuapp
              - devacademyl3e2/nrf54l10/cpuapp
              - devacademyl3e2/nrf54l10/cpuapp/ns
              - devacademyl3e2/nrf54l15/cpuapp
              - devacademyl3e2/nrf54l15/cpuapp/ns
              - devacademyl3e2/nrf54l15/cpuflpr
              - devacademyl3e2/nrf54l15/cpuflpr/xip
```
