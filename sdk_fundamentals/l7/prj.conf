## CMakeLists.txt
```
# SPDX-License-Identifier: Apache-2.0

cmake_minimum_required(VERSION 3.20.0)
find_package(Zephyr REQUIRED HINTS $ENV{ZEPHYR_BASE})
project(l7)

target_sources(app PRIVATE src/main.c)
```

## prj.conf
```kconfig
CONFIG_PRINTK=y

# CONFIG_TIMESLICING=n

CONFIG_TIMESLICING=y
CONFIG_TIMESLICE_SIZE=10
CONFIG_TIMESLICE_PRIORITY=0
```

## src/main.c
```c
/*
 * Copyright (c) 2016 Intel Corporation
 *
 * SPDX-License-Identifier: Apache-2.0
 */

#include <stdio.h>
#include <zephyr/kernel.h>
#include <zephyr/sys/printk.h>

#define SLEEP_TIME_MS   	5

// Thread stack size
#define THREAD0_STACKSIZE      512
#define THREAD1_STACKSIZE      512
#define WORQ_THREAD_STACK_SIZE 512

// Threads priorities
#define THREAD0_PRIORITY 2 
#define THREAD1_PRIORITY 3
#define WORKQ_PRIORITY   4

// Define stack area used by workqueue thread
static K_THREAD_STACK_DEFINE(my_stack_area, WORQ_THREAD_STACK_SIZE);

// Define queue structure
static struct k_work_q offload_work_q = {0};

static inline void emulate_work()
{
	for(volatile int count_out = 0; count_out < 300000; count_out++);
}

struct work_info {
    struct k_work work;
    char name[25];
} my_work;

void offload_function(struct k_work *work_term)
{
	emulate_work();
}

void thread0(void)
{
	uint64_t time_stamp;
	int64_t delta_time;
	
	k_work_queue_start(&offload_work_q, my_stack_area,
                   	K_THREAD_STACK_SIZEOF(my_stack_area), WORKQ_PRIORITY,
                   	NULL);
	strcpy(my_work.name, "Thread0 emulate_work()");
	k_work_init(&my_work.work, offload_function);

	while (1) {
		time_stamp = k_uptime_get();

		k_work_submit_to_queue(&offload_work_q, &my_work.work);
		// emulate_work();
		
		delta_time = k_uptime_delta(&time_stamp);
		printk("thread0 yielding this round in %lld ms\n", delta_time);
		k_msleep(20);
	}
}

void thread1(void)
{
    uint64_t time_stamp;
    int64_t delta_time;

    while (1) {
        time_stamp = k_uptime_get();
        emulate_work();
        delta_time = k_uptime_delta(&time_stamp);

        printk("thread1 yielding this round in %lld ms\n", delta_time);
        k_msleep(20);
    }   
}

K_THREAD_DEFINE(thread0_id, THREAD0_STACKSIZE, thread0, NULL, NULL, NULL, THREAD0_PRIORITY, 0, 0);
K_THREAD_DEFINE(thread1_id, THREAD1_STACKSIZE, thread1, NULL, NULL, NULL, THREAD1_PRIORITY, 0, 0);
```
