## CMakeLists.txt
```
cmake_minimum_required(VERSION 3.20.0)
find_package(Zephyr REQUIRED HINTS $ENV{ZEPHYR_BASE})
project(hello_world)

set(FILES 
    src/main.c 
)

target_sources(app PRIVATE ${FILES})
target_sources_ifdef(CONFIG_MYFUNCTION app PRIVATE src/myfunction.c)
```

## prj.conf
```kconfig
# Enable Segger RTT support
CONFIG_USE_SEGGER_RTT=n

# Enable RTT as the backend for the logging and console subsystems
CONFIG_LOG_BACKEND_RTT=n
CONFIG_RTT_CONSOLE=n

# Disable UART console to avoid routing standard output to physical pins
CONFIG_UART_CONSOLE=y

CONFIG_MYFUNCTION=y
```

## boards/nrf54l15dk_nrf54l15_cpuapp_ns.overlay
```dts
/* For more help, browse the devicetree documentation at https://docs.zephyrproject.org/latest/build/dts/index.html
 * You can also visit the nRF DeviceTree extension documentation at https://docs.nordicsemi.com/bundle/nrf-connect-vscode/page/guides/ncs_configure_app.html#devicetree-support-in-the-extension
 */
 &uart20 {
	current-speed = <9600>;
};
```

## src/main.c
```c
#include <zephyr/kernel.h>
#include <zephyr/sys/printk.h>

#ifdef CONFIG_MYFUNCTION
	#include "myfunction.h"
#endif

int main(void)
{

	while (1) {
#ifdef CONFIG_MYFUNCTION
		int a = 3, b = 4;
		printk("The sum of %d and %d is %d\n", a, b, sum(a, b));
#else
		printk("MYFUNCTION not enabled\n");
		return 0;
#endif
		k_msleep(1000);
	}
	return 0;
}
```
